## package/batocera/firmwares/rtkbt-aml/Config.in
```kconfig
config BR2_PACKAGE_RTKBT_AML
	bool "rtkbt-aml"
	help
	  Realtek UART bluetooth for Amlogic tv boxes (RTL8733BS and
	  friends): rtk_hciattach H5 loader with CoreELEC's patches plus
	  the firmware from CoreELEC/rtkbt-firmware-aml.

	  https://github.com/CoreELEC/rtkbt-firmware-aml
```

## package/batocera/gpu/mali-G310/Config.in
```kconfig
config BR2_PACKAGE_MALI_G310
	bool "mali-G310"
	depends on BR2_aarch64
	select BR2_PACKAGE_LIBDRM
	select BR2_PACKAGE_WAYLAND
	select BR2_PACKAGE_LINUX_FIRMWARE
	select BR2_PACKAGE_LINUX_FIRMWARE_ARM_MALI_CSF
	select BR2_PACKAGE_HAS_LIBEGL
	select BR2_PACKAGE_HAS_LIBGLES
	select BR2_PACKAGE_HAS_LIBMALI
	select BR2_PACKAGE_HAS_LIBGBM
	select BR2_PACKAGE_LIBGBM_HAS_FEATURE_DMA_BUF
	select BR2_PACKAGE_LIBGBM_HAS_FEATURE_FORMAT_MODIFIER_PLANE_COUNT
	help
	  Install the binary user-space libraries for the ARM Mali
	  G310 GPU found in Amlogic S7D/S6 (S905X5/S905X5M), as
	  shipped by CoreELEC (Valhall r44p0, wayland + gbm, dma-heap).
	  Requires the mali-kbase-aml kernel driver.

if BR2_PACKAGE_MALI_G310

config BR2_PACKAGE_PROVIDES_LIBMALI
	default "mali-G310"

config BR2_PACKAGE_PROVIDES_LIBEGL
	default "mali-G310"

config BR2_PACKAGE_PROVIDES_LIBGLES
	default "mali-G310"

config BR2_PACKAGE_PROVIDES_LIBGBM
	default "mali-G310"

endif
```

## package/batocera/gpu/mali-kbase-aml/Config.in
```kconfig
config BR2_PACKAGE_MALI_KBASE_AML
	bool "mali-kbase-aml"
	depends on BR2_LINUX_KERNEL
	depends on BR2_aarch64
	help
	  Mali Valhall r44p0 (CSF) kernel driver for Amlogic S7D/S6
	  (Mali-G310), built out of tree against the Amlogic vendor
	  kernel. Same sources and build options as CoreELEC.

	  https://github.com/CoreELEC/gpu-aml
```

## package/batocera/network/rtl8733bs/Config.in
```kconfig
comment "rtl8733bs needs a Linux kernel to be built"
	depends on !BR2_LINUX_KERNEL

config BR2_PACKAGE_RTL8733BS
	bool "rtl8733bs"
	depends on BR2_LINUX_KERNEL
	help
	  Realtek RTL8733BS SDIO wifi driver, as found in Amlogic
	  S905X5M (S7D) tv boxes. Same source as CoreELEC.

	  https://github.com/smp79/rtl8733BS_WiFi_linux_v5.15.17-113
```
